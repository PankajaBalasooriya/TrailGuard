#include <dht.h>
#include "DUST.h"
#include <SPI.h>
#include <Wire.h>
#include <Adafruit_GFX.h>
#include <Adafruit_SSD1306.h>

#define gas_pin 4
#define Dust_Apin A2
#define Dust_Dpin 3
#define Menu 7        
#define Select_Exit 9
#define turbidity_pin A0
#define ph_pin A1
#define TdsSensorPin A3
#define VREF 5.0      // analog reference voltage(Volt) of the ADC
#define SCOUNT  30  
#define DHT11_PIN 2

int analogBuffer[SCOUNT];    // store the analog value in the array, read from ADC
int analogBufferTemp[SCOUNT];
int analogBufferIndex = 0,copyIndex = 0;
float averageVoltage = 0,tdsValue,temperature = 25;
double phValue;
float volt;
float ntu;
int menuIndex = 0; 
int Oledpower = 0; 
int back = 0 ;
int temperature1,chk,humidity;
double gas_level,dustlevel;
float TDS_value, Ph_value, Turbidity;
bool manualOff = false;
unsigned long manualOffTime = 0;
const unsigned long manualOffDuration = 300000;
float TDS;

Adafruit_SSD1306 display(128, 64, &Wire, -1);
dht DHT;

float round_to_dp( float in_value, int decimal_place ){
  float multiplier = powf( 10.0f, decimal_place );
  in_value = roundf( in_value * multiplier ) / multiplier;
  return in_value;
}

int getMedianNum(int bArray[], int iFilterLen) {
      int bTab[iFilterLen];
      for (byte i = 0; i<iFilterLen; i++)
      bTab[i] = bArray[i];
      int i, j, bTemp;
      for (j = 0; j < iFilterLen - 1; j++) 
      {
      for (i = 0; i < iFilterLen - j - 1; i++) 
          {
        if (bTab[i] > bTab[i + 1]) 
            {
        bTemp = bTab[i];
            bTab[i] = bTab[i + 1];
        bTab[i + 1] = bTemp;
         }
      }
      }
      if ((iFilterLen & 1) > 0)
    bTemp = bTab[(iFilterLen - 1) / 2];
      else
    bTemp = (bTab[iFilterLen / 2] + bTab[iFilterLen / 2 - 1]) / 2;
      return bTemp;
}


const unsigned char myBitmap [] PROGMEM = {
	0x00, 0x00, 0x00, 0x00, 0x00, 0x00, 0x00, 0x00, 0x00, 0x00, 0x00, 0x00, 0x00, 0x00, 0x00, 0x00, 
	0x00, 0x00, 0x00, 0x00, 0x00, 0x00, 0x00, 0x00, 0x00, 0x00, 0x00, 0x00, 0x00, 0x00, 0x00, 0x00, 
	0x00, 0x00, 0x00, 0x00, 0x00, 0x00, 0x00, 0x00, 0x00, 0x00, 0x00, 0x00, 0x00, 0x00, 0x00, 0x00, 
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	0x00, 0x00, 0x00, 0x00, 0x00, 0x00, 0x00, 0x00, 0x00, 0x00, 0x00, 0x00, 0x00, 0x00, 0x00, 0x00
};

void setup() { 

  Serial.begin(9600);
  
  pinMode(Menu, INPUT);
  pinMode(Select_Exit, INPUT);
  
  pinMode(11, OUTPUT);
  pinMode(13,OUTPUT);
  pinMode(10, OUTPUT);
  pinMode(12, OUTPUT);
  pinMode(TdsSensorPin,INPUT);

  

  digitalWrite(12,HIGH);
  
  display.begin(SSD1306_SWITCHCAPVCC, 0x3C);
  display.clearDisplay();
  display.setTextColor(SSD1306_WHITE);
  display.drawBitmap(0, 0, myBitmap, 128, 64, SSD1306_WHITE);
  display.display();
  delay(2000);
}

void loop() {
  
  chk = DHT.read11(DHT11_PIN);
  temperature1 = DHT.temperature;
  humidity = DHT.humidity;
  
  gas_level = digitalRead(gas_pin);

  dustlevel= dust_density(Dust_Apin,Dust_Dpin);
  
  if ((gas_level==0.00 || dustlevel>300) && (manualOff == false)){
    digitalWrite(13,HIGH);

  }
  else{
    digitalWrite(13,LOW);
  }

  if ((manualOff == true) && (millis() - manualOffTime >= manualOffDuration)) {
    manualOff = false;
  }

  
  
  if (menuIndex == 0){
    display.clearDisplay();
    display.display();
  }

  if ((menuIndex == 1) && (Oledpower == 1) ){
    
    display.clearDisplay();
    display.setTextSize(1);
    
    display.setCursor(0, 16);
    display.print(temperature1);
    display.print(F(" C"));
    Serial.print(temperature1);
    Serial.println(F(" C"));
    
    display.setCursor(0, 32);
    display.print(humidity);
    display.print(F(" %"));
    Serial.print(humidity);
    Serial.println(F(" %"));
    
    display.display();
  }
  
  if (digitalRead(Menu)== HIGH && (Oledpower == 0)){
    menuIndex = 1;
    Oledpower = 1;
    delay(150);
  }
  
  if (digitalRead(Menu)== HIGH && (Oledpower == 1)){
    menuIndex = menuIndex + 1;
    if (menuIndex == 10){
      menuIndex = 2;
    }
    delay(150);
  }

  if ((menuIndex != 0) && (menuIndex != 1) && (Oledpower == 1) && (back == 0) ){
    // Serial.print(menuIndex);
    
      if (menuIndex < 6){
        display.clearDisplay();
        display.setCursor(0, 8 + ((menuIndex-2) * 16));
        display.print(F("> "));
        display.setCursor(10, 8);
        display.print(F("Water Quality"));
        display.setCursor(10, 24);
        display.print(F("pH value"));
        display.setCursor(10, 40);
        display.print(F("TDS value"));
        display.setCursor(10, 56);
        display.print(F("Turbidity"));
        display.display();
        
      }
      else{
        display.clearDisplay();
        display.setCursor(0, 8 + ((menuIndex-6) * 16));
        display.print(F("> "));
        display.setCursor(10, 8);
        display.print(F("Dust density"));
        display.setCursor(10, 24);
        display.print(F("Buzzer off"));
        display.setCursor(10, 40);
        display.print(F("Back"));
        display.setCursor(10, 56);
        display.print(F("Display off"));
        display.display();
        
      }
    
  }
    if((digitalRead(Select_Exit) == HIGH) && (menuIndex != 0) && (menuIndex != 1) && (Oledpower == 1) ){
    delay(200);
    back= (back + 1 ) % 2 ; 
    if (back == 1){ 
      if ( menuIndex == 2 ){
        digitalWrite(11, HIGH);
      

        for (int i=30 ; i>=0 ; i--){

          int analogValue = analogRead(A1); 

          if (i<=30 && i>10){
            digitalWrite(10,LOW);
            if (analogValue == 512) {
              phValue = 7; 
            } 
            else if (analogValue > 512) {
              phValue = 7-((float)analogValue-512)/512*7;
            }
            else {
              phValue = 7+((512-(float)analogValue)/512*7);
            }
          }

          else{
            Serial.println(analogRead(A3));
            int analogValue = 0;
            for (int i = 0; i < SCOUNT; i++) {
              analogValue += analogRead(TdsSensorPin);
              delay(10);
            }
            analogValue /= SCOUNT; // Average the samples

            float voltage = analogValue * (VREF / 1024.0); // Convert analog value to voltage
            float compensationCoefficient = 1.0 + 0.02 * (temperature - 25.0); // Temperature compensation
            float compensatedVoltage = voltage / compensationCoefficient; // Apply compensation
            float tdsValue = (133.42 * pow(compensatedVoltage, 3) 
                            - 255.86 * pow(compensatedVoltage, 2) 
                            + 857.39 * compensatedVoltage) * 0.5; 
            TDS=tdsValue;
            Serial.print(" ");
            Serial.println(tdsValue);
            
          
            
            volt = 0;

            for(int i=0; i<800; i++){
              volt += ((float)analogRead(turbidity_pin)/1024)*5;
            }
            volt = volt/800;
            volt = round_to_dp(volt,2);

            if(volt < 2.5){
              ntu = 300;}
            else{
              ntu = -112.04*square(volt)+574.23*volt-435.38; 
            }
          }
          display.clearDisplay();
          display.setCursor(0, 16);
          display.print(F("Wait "));
          display.print(i);
          display.print(F(" s"));
          display.display();
          delay(1000);
        }


        digitalWrite(11, LOW);
        if (TDS<0){
          TDS=0;
        }

        if (phValue<0){
          phValue=0;
        }

        if (ntu<0){
          ntu=0;
        }

        display.clearDisplay();
        if ((phValue > 6 && phValue < 8.5)  && (TDS < 500) && (ntu < 5 )) {
          display.setCursor(0, 16);
          display.print(F("Drinkable"));
        }
        else{
          display.setCursor(0, 16);
          display.print(F("Not Drinkabe"));
        } 
        
        if (phValue > 6 && phValue < 9) {

          display.setCursor(0, 32);
          display.print(F("Bathable"));
        }
        else{
          display.setCursor(0, 32);
          display.print(F("Not Bathable"));
        }
        display.display();
        

      }
      else if ( menuIndex == 3 ){
        display.clearDisplay();
        display.setCursor(0, 16);
        display.print(phValue);
        display.display();
      }
      else if ( menuIndex == 4 ){
        display.clearDisplay();
        display.setCursor(0, 16);
        display.print(TDS);
        display.display();
      }
      else if ( menuIndex == 5 ){
        display.clearDisplay();
        display.setCursor(0, 16);
        display.print(ntu);
        display.display();
      }
      else if ( menuIndex == 6 ){

        
        display.clearDisplay();
        if (dustlevel<0){
          dustlevel = 7.9 ;
        }
        display.setCursor(0, 16);
        display.print(dustlevel);
        display.print(" ug/m3");
        display.display();
          
      
      }
      else if ( menuIndex == 7 ){
        digitalWrite(13,LOW);
        manualOff = true;
        manualOffTime = millis();
        menuIndex = 1;
        back = 0;
      }

      else if ( menuIndex == 8 ){
        menuIndex = 1 ;
        back = 0 ;
      }
      else{
        menuIndex = 0 ;
        Oledpower = 0 ;
        back = 0 ;
      }
    }
  }
  
}



