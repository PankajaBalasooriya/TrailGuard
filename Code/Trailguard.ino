
#include "TDS.h"
#include <dht.h>
#include "DUST.h"
#include "TURBIDITY.h"
#include "PH.h"
#include <SPI.h>
#include <Wire.h>
#include <Adafruit_GFX.h>
#include <Adafruit_SSD1306.h>

#define gas_pin 4
#define TDS_pin A3
#define Dust_Apin A2
#define Dust_Dpin 3
#define turbidity_pin A0
#define PH_pin A1

      
#define Menu 7        
#define Select_Exit 9

Adafruit_SSD1306 display(128, 64, &Wire, -1);

int menuIndex = 0; 
int Oledpower = 0; 
int back = 0 ;

float TDS_value, Ph_value, Turbidity;
    

dht DHT;
#define DHT11_PIN 2
int temperature,chk,humidity;
double gas_level,dust_level;

bool manualOff = false;
unsigned long manualOffTime = 0;
const unsigned long manualOffDuration = 300000;

const unsigned char myBitmap [] PROGMEM = {
	0x00, 0x00, 0x00, 0x00, 0x00, 0x00, 0x00, 0x00, 0x00, 0x00, 0x00, 0x00, 0x00, 0x00, 0x00, 0x00, 
	0x00, 0x00, 0x00, 0x00, 0x00, 0x00, 0x00, 0x00, 0x00, 0x00, 0x00, 0x00, 0x00, 0x00, 0x00, 0x00, 
	0x00, 0x00, 0x00, 0x00, 0x00, 0x00, 0x00, 0x00, 0x00, 0x00, 0x00, 0x00, 0x00, 0x00, 0x00, 0x00, 
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	0x00, 0x00, 0x00, 0x00, 0x00, 0x00, 0x00, 0x00, 0x00, 0x00, 0x00, 0x00, 0x00, 0x00, 0x00, 0x00
};

void setup() {
  Serial.begin(9600);

  pinMode(Menu, INPUT);
  pinMode(Select_Exit, INPUT);
  
  pinMode(11, OUTPUT);
  pinMode(13,OUTPUT);
  pinMode(10, OUTPUT);

  digitalWrite(10,HIGH);
  
  display.begin(SSD1306_SWITCHCAPVCC, 0x3C);
  display.clearDisplay();
  display.setTextColor(SSD1306_WHITE);
  display.drawBitmap(0, 0, myBitmap, 128, 64, SSD1306_WHITE);
  display.display();
  delay(2000);
}

void loop() {
  
  chk = DHT.read11(DHT11_PIN);
  temperature = DHT.temperature;
  humidity = DHT.humidity;
  
  gas_level = digitalRead(gas_pin);
  dust_level = dust_density(Dust_Dpin,Dust_Apin);

  if ((gas_level==LOW || dust_level>100) && (manualOff == false)){
    digitalWrite(13,HIGH);
  }
  else{
    digitalWrite(13,LOW);
  }

  if ((manualOff == true) && (millis() - manualOffTime >= manualOffDuration)) {
    manualOff = false;
  }

  
  
  if (menuIndex == 0){
    display.clearDisplay();
    display.display();
  }

  if ((menuIndex == 1) && (Oledpower == 1) ){
    
    display.clearDisplay();
    display.setTextSize(1);
    
    display.setCursor(0, 16);
    display.print(temperature);
    display.print(F(" C"));
    Serial.print(temperature);
    Serial.println(F(" C"));
    
    display.setCursor(0, 32);
    display.print(humidity);
    display.print(F(" %"));
    Serial.print(humidity);
    Serial.println(F(" %"));
    
    display.display();
  }
  
  if (digitalRead(Menu)== HIGH && (Oledpower == 0)){
    menuIndex = 1;
    Oledpower = 1;
    delay(150);
  }
  
  if (digitalRead(Menu)== HIGH && (Oledpower == 1)){
    menuIndex = menuIndex + 1;
    if (menuIndex == 10){
      menuIndex = 2;
    }
    delay(150);
  }

  if ((menuIndex != 0) && (menuIndex != 1) && (Oledpower == 1) && (back == 0) ){
    // Serial.print(menuIndex);
    
      if (menuIndex < 6){
        display.clearDisplay();
        display.setCursor(0, 8 + ((menuIndex-2) * 16));
        display.print(F("> "));
        display.setCursor(10, 8);
        display.print(F("Water Quality"));
        display.setCursor(10, 24);
        display.print(F("pH value"));
        display.setCursor(10, 40);
        display.print(F("TDS value"));
        display.setCursor(10, 56);
        display.print(F("Turbidity"));
        display.display();
        
      }
      else{
        display.clearDisplay();
        display.setCursor(0, 8 + ((menuIndex-6) * 16));
        display.print(F("> "));
        display.setCursor(10, 8);
        display.print(F("Dust density"));
        display.setCursor(10, 24);
        display.print(F("Buzzer off"));
        display.setCursor(10, 40);
        display.print(F("Back"));
        display.setCursor(10, 56);
        display.print(F("Display off"));
        display.display();
        
      }
    
  }
    if((digitalRead(Select_Exit) == HIGH) && (menuIndex != 0) && (menuIndex != 1) && (Oledpower == 1) ){
    delay(200);
    back= (back + 1 ) % 2 ; 
    if (back == 1){ 
      if ( menuIndex == 2 ){
        digitalWrite(11, HIGH);

        for (int i=30 ; i>=0 ; i--){
          display.clearDisplay();
          display.setCursor(0, 16);
          display.print(F("Wait "));
          display.print(i);
          display.print(F(" s"));
          display.display();
          delay(1000);
        }
        
        TDS_value = tds_value(TDS_pin);
        Ph_value = ph_value(PH_pin);
        Turbidity = turbidity(turbidity_pin);

        display.clearDisplay();
        if ((Ph_value > 6 && Ph_value < 8.5) && (Turbidity < 5) && (TDS_value < 250)) {
          display.setCursor(0, 16);
          display.print(F("Drinkable"));
        }
        else{
          display.setCursor(0, 16);
          display.print(F("Not Drinkabe"));
        } 
        
        if (Ph_value > 6 && Ph_value < 9) {
          display.setCursor(0, 32);
          display.print(F("Bathable"));
        }
        else{
          display.setCursor(0, 32);
          display.print(F("Not Bathable"));
        }
        display.display();
        

      }
      else if ( menuIndex == 3 ){
        display.clearDisplay();
        display.setCursor(0, 16);
        display.print(Ph_value);
        display.display();
      }
      else if ( menuIndex == 4 ){
        display.clearDisplay();
        display.setCursor(0, 16);
        display.print(TDS_value);
        display.display();
      }
      else if ( menuIndex == 5 ){
        display.clearDisplay();
        display.setCursor(0, 16);
        display.print(Turbidity);
        display.display();
      }
      else if ( menuIndex == 6 ){

        
        display.clearDisplay();
        display.setCursor(0, 16);
        display.print(dust_level);
        display.print(" ug/m3");
        display.display();
          
      
      }
      else if ( menuIndex == 7 ){
        digitalWrite(13,LOW);
        manualOff = true;
        manualOffTime = millis();
        menuIndex = 1;
        back = 0;
      }

      else if ( menuIndex == 8 ){
        menuIndex = 1 ;
        back = 0 ;
      }
      else{
        menuIndex = 0 ;
        Oledpower = 0 ;
        back = 0 ;
      }
    }
  }
  
}



